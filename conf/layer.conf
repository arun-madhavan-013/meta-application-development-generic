## conf/layer.conf
```bitbake
# We have a conf and classes directory, add to BBPATH
BBPATH .= ":${LAYERDIR}"

# We have recipes-* directories, add to BBFILES
BBFILES += "${LAYERDIR}/recipes-*/*/*.bb \
            ${LAYERDIR}/recipes-*/*/*.bbappend"

BBFILE_COLLECTIONS += "application-development"
BBFILE_PATTERN_application-development = "^${LAYERDIR}/"
BBFILE_PRIORITY_application-development = "6"

LAYERDEPENDS_application-development = "core"
LAYERSERIES_COMPAT_application-development = "dunfell"
```

## conf/machine/include/application.inc
```bitbake
# To support layered ipk generation
APP_LAYER_ARCH = "${MACHINE}-apps"

PACKAGE_EXTRA_ARCHS_append = " ${APP_LAYER_ARCH}"

IPK_FEED_URIS += " "

require package_revisions.inc
```

## conf/machine/include/package_revisions.inc
```bitbake
PV_pn-rdkresident-app= "1.0.0"
PR_pn-rdkresident-app= "r0"
PACKAGE_ARCH_pn-lib32-rdkresident-app = "${APP_LAYER_ARCH}"

PV_pn-residentui= "1.0.0"
PR_pn-residentui= "r0"
PACKAGE_ARCH_pn-lib32-residentui = "${APP_LAYER_ARCH}"
```
